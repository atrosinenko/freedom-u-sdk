## conf/uboot-fit-image.its
```
/dts-v1/;

/ {
        description = "U-boot FIT image for HiFive Unleashed";
        #address-cells = <2>;

        images {
                bbl {
                        description = "BBL/SBI/riscv-pk";
                        data = /incbin/("../work/bbl.bin");
                        type = "kernel";
                        arch = "riscv";
                        os = "linux";
                        load = <0x80000000>;
                        entry = <0x80000000>;
                        compression = "none";
                        hash-1 {
                                algo = "md5";
                        };
                };

                kernel {
                        description = "Linux kernel";
                        data = /incbin/("../work/vmlinux.bin");
                        type = "kernel";
                        arch = "riscv";
                        os = "linux";
                        load = <0x80200000>;
                        compression = "none";
                        hash-1 {
                                algo = "md5";
                        };
                };

                ramdisk {
                        description = "buildroot initramfs";
                        data = /incbin/("../work/initramfs.cpio.gz");
                        type = "ramdisk";
                        arch = "riscv";
                        os = "linux";
                        load = <0x82000000>;
                        compression = "gzip";
                        hash-1 {
                                algo = "md5";
                        };
                };

                fdt {
                        data = /incbin/("../work/HiFive_U-Boot/arch/riscv/dts/zeowaa-1gb.dtb");
                        type = "flat_dt";
                        arch = "riscv";
                        load = <0x801f0000>;
                        compression = "none";
                        hash-1 {
                                algo = "md5";
                        };
                };
        };

        configurations {
                default = "config-1";

                config-1 {
                        description = "HiFive Unleashed with BBL";
                        kernel = "bbl";
                        fdt = "fdt";
                        loadables = "kernel", "ramdisk";
                };
        };
};
```
